## Config.in
```kconfig
menu "ASU Linux"
    source "$BR2_EXTERNAL_ASU_LINUX_PATH/package/dora/Config.in"
endmenu
```

## configs/pumpkin-mbm2_defconfig
```kconfig
BR2_arm=y
BR2_cortex_a8=y
BR2_TOOLCHAIN_BUILDROOT_GLIBC=y
BR2_PACKAGE_HOST_LINUX_HEADERS_CUSTOM_5_4=y
BR2_TOOLCHAIN_BUILDROOT_CXX=y
BR2_TAR_OPTIONS="--no-same-owner"
BR2_CCACHE=y
BR2_GLOBAL_PATCH_DIR="${BR2_EXTERNAL}/board/pumpkin-mbm2/patches"
BR2_TARGET_GENERIC_HOSTNAME="mbm2"
BR2_ROOTFS_DEVICE_CREATION_DYNAMIC_EUDEV=y
BR2_ROOTFS_DEVICE_TABLE="system/device_table.txt $(BR2_EXTERNAL)/board/pumpkin-mbm2/device_table.txt"
BR2_TARGET_GENERIC_GETTY_PORT="ttyS0"
BR2_TARGET_GENERIC_GETTY_BAUDRATE_115200=y
BR2_ROOTFS_USERS_TABLES="${BR2_EXTERNAL}/board/pumpkin-mbm2/users.txt"
BR2_ROOTFS_OVERLAY="$(BR2_EXTERNAL)/board/pumpkin-mbm2/rootfs_overlay"
BR2_ROOTFS_POST_IMAGE_SCRIPT="${BR2_EXTERNAL}/board/pumpkin-mbm2/post_image.sh"
BR2_ROOTFS_POST_SCRIPT_ARGS="${BR2_TARGET_UBOOT_CUSTOM_REPO_VERSION}"
BR2_LINUX_KERNEL=y
BR2_LINUX_KERNEL_CUSTOM_TARBALL=y
BR2_LINUX_KERNEL_CUSTOM_TARBALL_LOCATION="$(call github,beagleboard,linux,5.4.106-ti-r41)/linux-5.4.106-ti-r41.tar.gz"
BR2_LINUX_KERNEL_USE_CUSTOM_CONFIG=y
BR2_LINUX_KERNEL_CUSTOM_CONFIG_FILE="${BR2_EXTERNAL}/board/pumpkin-mbm2/linux.config"
BR2_LINUX_KERNEL_CONFIG_FRAGMENT_FILES="${BR2_EXTERNAL}/linux-localversion.config"
BR2_LINUX_KERNEL_LZ4=y
BR2_LINUX_KERNEL_DTS_SUPPORT=y
BR2_LINUX_KERNEL_CUSTOM_DTS_PATH="${BR2_EXTERNAL}/board/pumpkin-mbm2/pumpkin-mbm2.dts ${BR2_EXTERNAL}/board/pumpkin-mbm2/am33xx-boneblack.dtsi"
BR2_LINUX_KERNEL_NEEDS_HOST_OPENSSL=y
BR2_PACKAGE_BUSYBOX_CONFIG="${BR2_EXTERNAL}/board/pumpkin-mbm2/busybox.config"
BR2_PACKAGE_BUSYBOX_SHOW_OTHERS=y
BR2_PACKAGE_PV=y
BR2_PACKAGE_SPIDEV_TEST=y
BR2_PACKAGE_DOSFSTOOLS=y
BR2_PACKAGE_DOSFSTOOLS_FSCK_FAT=y
BR2_PACKAGE_E2FSPROGS=y
BR2_PACKAGE_E2FSPROGS_DEBUGFS=y
BR2_PACKAGE_E2FSPROGS_RESIZE2FS=y
BR2_PACKAGE_PARTED=y
BR2_PACKAGE_RTC_TOOLS=y
BR2_PACKAGE_SPI_TOOLS=y
BR2_PACKAGE_UBOOT_TOOLS=y
BR2_PACKAGE_UBOOT_TOOLS_FIT_SUPPORT=y
BR2_PACKAGE_UBOOT_TOOLS_MKIMAGE=y
BR2_PACKAGE_USBMOUNT=y
BR2_PACKAGE_USBUTILS=y
BR2_PACKAGE_LIBCURL=y
BR2_PACKAGE_LIBCURL_CURL=y
BR2_PACKAGE_LIBRSYNC=y
BR2_PACKAGE_DROPBEAR=y
BR2_PACKAGE_DROPBEAR_DISABLE_REVERSEDNS=y
BR2_PACKAGE_IFTOP=y
BR2_PACKAGE_LRZSZ=y
BR2_PACKAGE_RSYNC=y
BR2_PACKAGE_MONIT=y
BR2_PACKAGE_RSYSLOG=y
BR2_PACKAGE_UTIL_LINUX_LIBFDISK=y
BR2_PACKAGE_UTIL_LINUX_HWCLOCK=y
BR2_PACKAGE_UTIL_LINUX_KILL=y
BR2_PACKAGE_UTIL_LINUX_MOUNT=y
BR2_PACKAGE_UTIL_LINUX_UUIDD=y
BR2_PACKAGE_LESS=y
BR2_PACKAGE_NANO=y
BR2_PACKAGE_VIM=y
BR2_TARGET_ROOTFS_EXT2=y
BR2_TARGET_ROOTFS_EXT2_4=y
BR2_TARGET_ROOTFS_EXT2_SIZE="128M"
BR2_TARGET_ROOTFS_TAR_LZMA=y
BR2_TARGET_UBOOT=y
BR2_TARGET_UBOOT_BUILD_SYSTEM_KCONFIG=y
BR2_TARGET_UBOOT_CUSTOM_GIT=y
BR2_TARGET_UBOOT_CUSTOM_REPO_URL="https://github.com/ASU-cubesat/sparcs-uboot"
BR2_TARGET_UBOOT_CUSTOM_REPO_VERSION="v0.5"
BR2_TARGET_UBOOT_USE_CUSTOM_CONFIG=y
BR2_TARGET_UBOOT_CUSTOM_CONFIG_FILE="${BR2_EXTERNAL}/board/pumpkin-mbm2/uboot.config"
BR2_TARGET_UBOOT_NEEDS_DTC=y
BR2_TARGET_UBOOT_FORMAT_IMG=y
BR2_TARGET_UBOOT_SPL=y
BR2_TARGET_UBOOT_SPL_NAME="MLO"
BR2_PACKAGE_HOST_DOSFSTOOLS=y
BR2_PACKAGE_HOST_GENEXT2FS=y
BR2_PACKAGE_HOST_GENIMAGE=y
BR2_PACKAGE_HOST_MTOOLS=y
BR2_PACKAGE_SPARCS_PLP_RUST=y
BR2_PACKAGE_SPARCS_PLP_RUST_REPO_URL="https://github.com/ASU-cubesat/sparcs-plp-rust"
BR2_PACKAGE_SPARCS_PLP_RUST_REPO_VERSION="main"
```

## package/dora/Config.in
```kconfig
config BR2_PACKAGE_DORA
    bool "sparcs-plp-rust"
    depends on BR2_PACKAGE_HOST_RUSTC_TARGET_ARCH_SUPPORTS
    select BR2_PACKAGE_HOST_RUSTC
    help
        Build and include the sparcs-plp-rust binaries on the target

config BR2_PACKAGE_DORA_REPO_URL
    string "URL of git repository"
    depends on BR2_PACKAGE_DORA

config BR2_PACKAGE_DORA_REPO_VERSION
    string "Git repository version"
    help
      Revision to use in the typical format used by
      git, e.g. a tag, commit, branch, etc.
    depends on BR2_PACKAGE_DORA
```

## package/sparcs_plp_rust/Config.in
```kconfig
config BR2_PACKAGE_SPARCS_PLP_RUST
    bool "sparcs-plp-rust"
    help
        Build and include the sparcs-plp-rust binaries (only works on BBB)

        http://example.com

#if BR2_PACKAGE_SPARCS_PLP_RUST
#choice

config BR2_PACKAGE_SPARCS_PLP_RUST_REPO_URL
        string "URL of git repository"
        depends on BR2_PACKAGE_SPARCS_PLP_RUST

config BR2_PACKAGE_SPARCS_PLP_RUST_REPO_VERSION
        string "Git repository version"
        help
          Revision to use in the typical format used by
          git, e.g. a tag, branch, commit, etc.
        depends on BR2_PACKAGE_SPARCS_PLP_RUST
```

## package/sparcs_plp_rust_cargo/Config.in
```kconfig
config BR2_PACKAGE_SPARCS_PLP_RUST_CARGO
    bool "sparcs-plp-rust-cargo"
    depends on BR2_PACKAGE_HOST_RUSTC_TARGET_ARCH_SUPPORTS
    select BR2_PACKAGE_HOST_RUSTC 
    help
        Build and include the sparcs-plp-rust binaries on the target

config BR2_PACKAGE_SPARCS_PLP_RUST_CARGO_REPO_URL
        string "URL of git repository"
        depends on BR2_PACKAGE_SPARCS_PLP_RUST_CARGO

config BR2_PACKAGE_SPARCS_PLP_RUST_CARGO_REPO_VERSION
        string "Git repository version"
        help
          Revision to use in the typical format used by
          git, e.g. a tag, commit, branch, etc.
        depends on BR2_PACKAGE_SPARCS_PLP_RUST_CARGO
```
